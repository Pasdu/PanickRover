/*
* Robot control version 1.0
* Designed by Michael Walsh
* using the DFRobotShop Roverr V2.0 Base
* Code Started on : Saturday, April 16th, 2016
* I know nothing of the legal details regarding this code
*/

//Initialize Infrared Receiver
#include <IRremote.h>
IRrecv irrecv(IRpin);

decode_results results;

//Establish Standard Pins for Motor Control
int leftSpeed = 6;   //Left Motor Speed Control
int leftSpeed = 5;   //Right Motor Speed Control
int leftMotor = 8;   //Left Motor Direciton Control
int rightMotor = 7;   //Right Motor Direction Control

//Establish Standard Pins for Sensor input
int IRpin = 11;    // Establishes the Pin number for Infrared Input

//Set up the pointer function to interpret codes.

void setup() {
  Serial.begin(9600);
  irrecv.enableIRln(); // Start the receiver
}

void loop() {
    // This line checks if anything has been received and makes the code available to read.
    if(irrecv.decode(&results)){
      Serial.println(results.value, HEX);

      irrecv.resume(); //Receive the next value
    }
  }

/*setM is used to set the direction of the motors
 * The motor param determines which motor we set
 *  0 is the left motor
 *  1 is the right motor
 *  2 is both motors
 * The reverse parameter is a boolean value
 * false means that the motor will spin forwards (relative to the bot)
 * true means that the motor will spin in referse (relative to the box)
 */
void SetM(int motor = 2, bool reverse = 0){
  switch(motor){
     case 0:
      digitalWrite(leftMotor, reverse);
      break;
     case 1:
      digitalWrite(rightMotor, reverse);
      break;
     case 2:
      digitalWrite(rightMotor, reverse);
      digitalWrite(leftMotor, reverse);
     break;
  }
  return;
}

/*SetV is used to set the velocity of a given motor, or both
 * The motor parameter is an integer used to define which motor is to be controlled
 * 0 for left motor
 * 1 for the right motor
 * 2 for both
 * The value parameter is a 0-255 value that scales to the minimum and maximum outputs to
 * the motor, setting this to 0 will cause the motor to not turn and 255 to turn at full speed.
 */
void SetV( int motor = 2, int value = 0) {
  switch(motor){
    case 0:
      analogWrite(leftMotor, value);
      break;
    case 1:
      analogWrite(rightMotor, value);
      break;
    case 2:
      analogWrite(rightMotor, value);
      analogWrite(leftMotor, value);
      break;
  }
}

//This is where the functions that govern the responses generated by the IR Remote

/* Forward Button function
 *  This function simply enables or disables both motors in the forward direciton
 *  It does
 */
void MoveForward(bool enable = true){
  SetM(2, false);
  
}

